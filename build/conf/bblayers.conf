## build/conf/bblayers.conf
```bitbake
# LAYER_CONF_VERSION is increased each time build/conf/bblayers.conf
# changes incompatibly
LCONF_VERSION = "6"

BBPATH = "${TOPDIR}"
BBFILES ?= ""
BBLAYERS ?= " \
  /home/user/work/edison/github/edison-src/poky/meta \
  /home/user/work/edison/github/edison-src/poky/meta-yocto \
  /home/user/work/edison/github/edison-src/poky/meta-yocto-bsp \
  /home/user/work/edison/github/edison-src/device-software/meta-edison \
  /home/user/work/edison/github/edison-src/device-software/meta-edison-distro \
  /home/user/work/edison/github/edison-src/device-software/meta-edison-middleware \
  /home/user/work/edison/github/edison-src/device-software/meta-edison-arduino \
  /home/user/work/edison/github/edison-src/device-software/meta-edison-devtools \
  \
  "
BBLAYERS_NON_REMOVABLE ?= " \
  /home/user/work/edison/github/edison-src/poky/meta \
  /home/user/work/edison/github/edison-src/poky/meta-yocto \
  "
```

## build/conf/local.conf
```bitbake
BB_NUMBER_THREADS = "4"
PARALLEL_MAKE = "-j 4"
MACHINE = "edison"
DISTRO = "poky-edison"
USER_CLASSES ?= "buildstats image-mklibs image-prelink"
PATCHRESOLVE = "noop"
CONF_VERSION = "1"
EDISONREPO_TOP_DIR = "/home/user/work/edison/github/edison-src"
DL_DIR ?= "/home/user/work/edison/bb_downloads"
SSTATE_DIR ?= "/home/user/work/edison/bb_sstate"
BUILDNAME = "Custom Edison build by user@nibbler_gentoo 2015-03-18 22:15:20 FET"
LICENSE_FLAGS_WHITELIST += "commercial"
COPY_LIC_MANIFEST = "1"
COPY_LIC_DIRS = "1"
FILESYSTEM_PERMS_TABLES = "/home/user/work/edison/github/edison-src/device-software/meta-edison-distro/files/fs-perms.txt"


SDKMACHINE = "x86_64"
```
